## firmware/sdkconfig.defaults
```kconfig
# Common configuration for all boards
# Target-specific defaults are in sdkconfig.defaults.{IDF_TARGET}

CONFIG_PARTITION_TABLE_CUSTOM=y
CONFIG_PARTITION_TABLE_CUSTOM_FILENAME="partitions.csv"
CONFIG_PARTITION_TABLE_OFFSET=0x8000

# IPv6 Configuration
CONFIG_LWIP_IPV6_AUTOCONFIG=y
CONFIG_LWIP_IPV6_NUM_ADDRESSES=12
CONFIG_LWIP_MULTICAST_PING=y
CONFIG_LWIP_IPV6_RDNSS_MAX_DNS_SERVERS=2
CONFIG_LWIP_NETIF_LOOPBACK=y
CONFIG_LWIP_IPV6_ND6_ROUTE_INFO_OPTION_SUPPORT=y
CONFIG_LWIP_IPV6_ND6_NUM_NEIGHBORS=10
CONFIG_LWIP_IPV6_ND6_NUM_ROUTERS=10
CONFIG_LWIP_IPV6_ND6_NUM_PREFIXES=10

CONFIG_LWIP_HOOK_IP6_ROUTE_DEFAULT=n
CONFIG_LWIP_HOOK_ND6_GET_GW_DEFAULT=n
CONFIG_ENABLE_ROUTE_HOOK=n

# SPIRAM configuration
CONFIG_SPIRAM=y

# Increase stack sizes for Matter
CONFIG_CHIP_TASK_STACK_SIZE=15360
CONFIG_ESP_MAIN_TASK_STACK_SIZE=10240

# Increase UDP endpoints for commissioner
CONFIG_NUM_UDP_ENDPOINTS=16

# Commissioning queue
CONFIG_MAX_EVENT_QUEUE_SIZE=100

# Matter Configuration
CONFIG_ESP_MATTER_ENABLE_MATTER_SERVER=n
CONFIG_ENABLE_CHIP_CONTROLLER_BUILD=y
CONFIG_ESP_MATTER_CONTROLLER_ENABLE=y
CONFIG_ESP_MATTER_COMMISSIONER_ENABLE=y

# Security
CONFIG_MBEDTLS_HKDF_C=y

# Debugging
CONFIG_ENABLE_CHIP_SHELL=y
CONFIG_ESP_MATTER_CONSOLE_TASK_STACK=4096
CONFIG_CHIP_SHELL_CMD_LINE_BUF_MAX_LENGTH=512

# BLE / Thread
CONFIG_ENABLE_CHIPOBLE=n
CONFIG_ENABLE_MATTER_OVER_THREAD=n
CONFIG_BT_ENABLED=n

# HTTP Server
CONFIG_HTTPD_WS_SUPPORT=y
CONFIG_HTTPD_MAX_REQ_HDR_LEN=2048

# Slave ESP32 for dual-core support
CONFIG_SLAVE_IDF_TARGET_ESP32C6=y

# mDNS (minimal implementation)
CONFIG_USE_MINIMAL_MDNS=y

# Wi-Fi softAP
CONFIG_ESP_WIFI_SOFTAP_SUPPORT=n

# SSL/TLS (disabled for development - DANGEROUS for production)
CONFIG_ESP_TLS_INSECUE=y
CONFIG_ESP_TLS_SKIP_SERVER_CERT_VERIFY=y

# SD card and FATFS
CONFIG_FATFS_LFN_HEAP=y
CONFIG_FATFS_MAX_LFN=255
```
